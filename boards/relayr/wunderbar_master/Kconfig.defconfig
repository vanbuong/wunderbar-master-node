## boards/relayr/wunderbar_master/board.yml
```yaml
board:
  name: wunderbar_master
  full_name: Relayr WunderBar Master Module
  vendor: relayr
  socs:
    - name: mk64f12
```

## drivers/wifi/gs1500m/Kconfig
```kconfig
# Copyright (c) 2026
# SPDX-License-Identifier: Apache-2.0

menuconfig WIFI_GS1500M_AT
	bool "GainSpan GS1500M AT WiFi offload"
	default y
	depends on DT_HAS_GAINSPAN_GS1500M_AT_ENABLED
	select WIFI
	select WIFI_OFFLOAD
	select NET_L2_WIFI_MGMT
	select NET_OFFLOAD
	help
	  UART AT offload driver for the GainSpan GS1500M Serial2WiFi module.
	  Reuses the portable lib/wifi/gs1500m AT library. Exposes Zephyr
	  wifi_mgmt plus IPv4 TCP/UDP net_offload (client). Module DNSLOOKUP
	  is available via gs1500m_dns_lookup(); listen/accept and TLS socket
	  offload are not implemented yet.
	  Enable the gs1500m DT node (status okay) from the application overlay.

if WIFI_GS1500M_AT

config WIFI_GS1500M_AT_WORKQ_STACK_SIZE
	int "GS1500M WiFi workqueue stack size"
	default 8192

config WIFI_GS1500M_AT_WORKQ_PRIORITY
	int "GS1500M WiFi workqueue priority"
	default 7

config WIFI_GS1500M_AT_RX_STACK_SIZE
	int "GS1500M AT RX poll thread stack size"
	default 1024

config WIFI_GS1500M_AT_RX_PRIORITY
	int "GS1500M AT RX poll thread priority"
	default 8

config WIFI_GS1500M_AT_INIT_TIMEOUT_MS
	int "Module AT bring-up timeout (ms)"
	default 8000

config WIFI_GS1500M_AT_MAX_SOCKETS
	int "Max concurrent offload sockets"
	default 4
	range 1 16

config WIFI_GS1500M_AT_TX_BUF_SIZE
	int "TX linearization buffer for net_offload send"
	default 1500
	range 64 9999

endif # WIFI_GS1500M_AT
```

## dts/bindings/misc/relayr,bt-nrf51822.yaml
```yaml
# Copyright (c) 2026
# SPDX-License-Identifier: Apache-2.0

description: WunderBar nRF51822 BT SPI slave (host side)

compatible: "relayr,bt-nrf51822"

include: [spi-device.yaml]
```

## dts/bindings/wifi/gainspan,gs1500m-at.yaml
```yaml
# Copyright (c) 2026
# SPDX-License-Identifier: Apache-2.0

description: GainSpan GS1500M Serial2WiFi (AT UART offload)

compatible: "gainspan,gs1500m-at"

include: uart-device.yaml

properties:
  reset-gpios:
    type: phandle-array
    description: WIFI_!RESET (active low)

  pgm-gpios:
    type: phandle-array
    description: |
      WIFI_PGM. High during reset enters flash-download mode; leave floating
      or drive low for normal Serial2WiFi run mode.

  intf-sel-gpios:
    type: phandle-array
    description: WIFI_INTF_SEL (UART vs SPI select)

  target-speed:
    type: int
    description: Preferred UART baud after bring-up (default 115200)
```

## tests/ztest/wb_log/testcase.yaml
```yaml
common:
  tags:
    - wb_log
tests:
  wunderbar.wb_log.unit:
    type: unit
  wunderbar.wb_log.native:
    platform_allow:
      - native_sim
      - native_sim/native/64
    integration_platforms:
      - native_sim
```
